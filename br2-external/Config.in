## br2-external/configs/f1c200s_devboard_defconfig
```kconfig
# F1C200S Dev Board - Buildroot defconfig
# ARM926EJ-S (ARMv5TE), 64MB SiP DDR1, SD card boot

# Architecture
BR2_arm=y
BR2_arm926t=y
BR2_ARM_INSTRUCTIONS_THUMB=y

# Toolchain - musl for small footprint
BR2_TOOLCHAIN_BUILDROOT_MUSL=y

# System
BR2_TARGET_GENERIC_HOSTNAME="f1c200s"
BR2_TARGET_GENERIC_ISSUE="F1C200S Dev Board"
BR2_TARGET_GENERIC_GETTY_PORT="ttyS0"
BR2_TARGET_GENERIC_GETTY_BAUDRATE_115200=y
BR2_INIT_BUSYBOX=y
BR2_SYSTEM_BIN_SH_BUSYBOX=y
BR2_TARGET_GENERIC_ROOT_PASSWD="root"

# Linux kernel
BR2_KERNEL_HEADERS_6_19=y
BR2_LINUX_KERNEL=y
BR2_LINUX_KERNEL_CUSTOM_VERSION=y
BR2_LINUX_KERNEL_CUSTOM_VERSION_VALUE="6.19.11"
BR2_LINUX_KERNEL_USE_DEFCONFIG=y
BR2_LINUX_KERNEL_DEFCONFIG="multi_v5"
BR2_LINUX_KERNEL_CONFIG_FRAGMENT_FILES="$(BR2_EXTERNAL_F1C200S_PATH)/board/f1c200s-devboard/linux.fragment"
BR2_LINUX_KERNEL_PATCH="$(BR2_EXTERNAL_F1C200S_PATH)/board/f1c200s-devboard/linux-patches"
BR2_LINUX_KERNEL_DTS_SUPPORT=y
BR2_LINUX_KERNEL_CUSTOM_DTS_PATH="$(BR2_EXTERNAL_F1C200S_PATH)/board/f1c200s-devboard/dts/suniv-f1c200s-devboard.dts"

# U-Boot bootloader
BR2_TARGET_UBOOT=y
BR2_TARGET_UBOOT_BUILD_SYSTEM_KCONFIG=y
BR2_TARGET_UBOOT_CUSTOM_VERSION=y
BR2_TARGET_UBOOT_CUSTOM_VERSION_VALUE="2025.01"
BR2_TARGET_UBOOT_BOARD_DEFCONFIG="licheepi_nano"
BR2_TARGET_UBOOT_CONFIG_FRAGMENT_FILES="$(BR2_EXTERNAL_F1C200S_PATH)/board/f1c200s-devboard/uboot.fragment"
BR2_TARGET_UBOOT_CUSTOM_DTS_PATH="$(BR2_EXTERNAL_F1C200S_PATH)/board/f1c200s-devboard/dts-uboot/suniv-f1c200s-devboard.dts"
BR2_TARGET_UBOOT_NEEDS_DTC=y
BR2_TARGET_UBOOT_NEEDS_PYLIBFDT=y
BR2_TARGET_UBOOT_NEEDS_OPENSSL=y
BR2_TARGET_UBOOT_SPL=y
BR2_TARGET_UBOOT_SPL_NAME="u-boot-sunxi-with-spl.bin"

# Packages
BR2_PACKAGE_DROPBEAR=y
BR2_PACKAGE_WPA_SUPPLICANT=y
BR2_PACKAGE_WPA_SUPPLICANT_NL80211=y
BR2_PACKAGE_WPA_SUPPLICANT_AUTOSCAN=y
BR2_PACKAGE_LINUX_FIRMWARE=y
BR2_PACKAGE_LINUX_FIRMWARE_RTL_81XX=y

BR2_PACKAGE_RSYNC=y
BR2_PACKAGE_HTOP=y            # process viewer
BR2_PACKAGE_TREE=y            # directory tree
BR2_PACKAGE_FILE=y            # `file` command
BR2_PACKAGE_YAVTA=y           # V4L2 raw frame dump (camera bring-up)
BR2_PACKAGE_I2C_TOOLS=y       # i2cdetect / i2cget / i2cset (sensor debug)
BR2_INSTALL_LIBSTDCPP=y       # C++ stdlib (required by libv4l_utils)
BR2_PACKAGE_LIBV4L=y          # V4L2 abstraction library
BR2_PACKAGE_LIBV4L_UTILS=y    # media-ctl, v4l2-ctl, v4l2-compliance


# Root filesystem
BR2_TARGET_ROOTFS_EXT2=y
BR2_TARGET_ROOTFS_EXT2_4=y
BR2_TARGET_ROOTFS_EXT2_SIZE="128M"
# BR2_TARGET_ROOTFS_TAR is not set
BR2_ROOTFS_OVERLAY="$(BR2_EXTERNAL_F1C200S_PATH)/board/f1c200s-devboard/rootfs-overlay"
BR2_ROOTFS_POST_BUILD_SCRIPT="$(BR2_EXTERNAL_F1C200S_PATH)/board/f1c200s-devboard/post-build.sh"
BR2_ROOTFS_POST_IMAGE_SCRIPT="$(BR2_EXTERNAL_F1C200S_PATH)/board/f1c200s-devboard/post-image.sh"

# Host tools for image generation
BR2_PACKAGE_HOST_DOSFSTOOLS=y
BR2_PACKAGE_HOST_E2FSPROGS=y
BR2_PACKAGE_HOST_GENIMAGE=y
BR2_PACKAGE_HOST_MTOOLS=y
BR2_PACKAGE_HOST_UBOOT_TOOLS=y
```
